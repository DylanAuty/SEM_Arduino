/* SEM_Control 
* Arduino code to handle:
*	- Opening and closing the purge valve periodically
*	- Reading of mean temperature data from 4 thermistors
*		- Storing these values to SD card
*		- Sending these values over XBee to another Arduino
*	- Using temperature data to linearly control the fan system (via a PWM fan controller)
*	- Reading battery voltages from I2C (another system does the measurement)
*	- Updating the HUD.
*	
* Dylan Auty, 23 June 2016
*/

// avr-libc library includes
#include <avr/io.h>
#include <avr/interrupt.h>

#include <I2C.h>	// Alternative library for I2C communication
					// dsscircuits.com/articles/arduino-i2c-master-library


// DEFINE PINS
#define PURGE_PIN 13		// Any digital IO pin.
#define FAN_CONTROL_PIN 45	// Connect Tx pin of a serial port to S1 on Syren 10a. Choices are 1, 18, 16 and 14 on mega2560.
#define THERMISTOR_IN_1 A0	// These 5 for analog input pins from the thermistors.
#define THERMISTOR_IN_2 A1
#define THERMISTOR_IN_3 A2
#define THERMISTOR_IN_4 A3
#define THERMISTOR_IN_5 A4
#define I2C_SDA 20			// Pins for I2C communication
#define I2C_SCL 21


// DEFINE RUNNING PARAMETERS/SETTINGS
// Fuel cell purge valve timing
#define PURGE_CLOSED_SECONDS 5 					// Purge valve times only accurate to increments of 0.5 seconds.
#define PURGE_OPEN_SECONDS 3

// Fuel cell temp measurement and control
#define FUEL_CELL_IDEAL_TEMP 40					// In degrees C
#define FUEL_CELL_INDIVIDUAL_MAX_TEMP 60		// If any one temp sensor reads above this, fans will output full..
#define FUEL_CELL_STANDARD_FANSPEED 170 		// This on a scale of 0-255 for full stop to full go.
#define FUEL_CELL_MIN_FANSPEED 50				// Fan speed will not drop below this.
#define FUEL_CELL_FAN_CONTROL_SENSITIVITY 8.5	// In speed units (0-255) per degree C.

// Setup I2C addresses
// Forbidden addresses: 0 to 7, 120 to 127.
#define BMS_VOLTAGE_1_ADDR 85 	// Test runs with address 85
#define BMS_VOLTAGE_2_ADDR 86
#define BMS_VOLTAGE_3_ADDR 87
#define BMS_VOLTAGE_4_ADDR 88
#define BMS_VOLTAGE_5_ADDR 89
#define BMS_VOLTAGE_6_ADDR 90
#define BMS_VOLTAGE_7_ADDR 91
#define BMS_VOLTAGE_8_ADDR 92
#define BMS_VOLTAGE_9_ADDR 93

#define BMS_REQUEST_TIMEOUT 40			// Timeout for BMS voltage sensor poll in ms.

// Global variables for valve timing, accessible from ISR.
volatile int time1Counter = 0;		// Timer 1, to check time between purge valve openings.
volatile byte valveOpen = 0;		// Flag to signal whether purge valve is open or not.
volatile int valveOpenCounter = 0;	// Timer 1, to check how long the purge valve has been open for.
volatile int BMS_addr_arr[9] = {BMS_VOLTAGE_1_ADDR, BMS_VOLTAGE_2_ADDR, BMS_VOLTAGE_3_ADDR, BMS_VOLTAGE_4_ADDR, BMS_VOLTAGE_5_ADDR, BMS_VOLTAGE_6_ADDR, BMS_VOLTAGE_7_ADDR, BMS_VOLTAGE_8_ADDR, BMS_VOLTAGE_9_ADDR};

// Lookup table for thermistor values
// Array of 1024 temperature values
volatile double thermistorTempLUT[1024] = 
{
125.0, 125.0, 125.0, 125.0, 125.0, 125.0, 125.0, 125.0, 125.0, 125.0, 125.0, 125.0,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 -50.0, -50.0};

void setup(){
	// Initialise pins
    pinMode(PURGE_PIN, OUTPUT);
 	pinMode(FAN_CONTROL_PIN, OUTPUT);
	
	// Start fans at standard fanspeed
	analogWrite(FAN_CONTROL_PIN, FUEL_CELL_STANDARD_FANSPEED);
	
	// Join I2C bus with no address
	//Wire.begin();
	I2c.begin();
	I2c.timeOut(BMS_REQUEST_TIMEOUT);
	//*** INTERRUPT TIMER FOR PURGE VALVE *** //
    // Uncomment to re-enable purge valve control
	/*
	// Initialise timer for purge valve interrupts
    cli();          // disable global interrupts
    TCCR1A = 0;     // set entire TCCR1A register to 0
    TCCR1B = 0;     // same for TCCR1B
	
    // set compare match register to desired timer count:
    // Arduino Mega 2560 has 16MHz clock
	// Divide by 1024 to get 15625 Hz.
	// Desired resolution of purge valve is 0.5s => 7812 counts until interrupt.
	OCR1A = 7812;
    // turn on CTC mode:
    TCCR1B |= (1 << WGM12);
    // Set CS10 and CS12 bits for 1024 prescaler, 16MHz clock -> 15.625kHz increments.:
    TCCR1B |= (1 << CS10);
    TCCR1B |= (1 << CS12);
    // enable timer compare interrupt:
    TIMSK1 |= (1 << OCIE1A);
    // enable global interrupts:
    sei();
	*/

	// Initialise serial connections
	Serial.begin(9600);		// Serial reserved for USB connection.
	Serial1.begin(9600);	// Serial1 on pins Rx:19, Tx:18.	
	
	// Wait 5 seconds for everything to settle
	Serial.println("=== BOOTING... ===");
	delay(1000);
	Serial.println("=== BEGIN === ");
}
 
void loop(){
	double temperatureArr[6] = {0, 0, 0, 0, 0, 0};	// contains: [therm 1-5 in C, ave temp]
	double BMSVoltageArr[9] = {0, 0, 0, 0, 0, 0, 0, 0, 0};	// BMS voltage sensors 1-10

	// Poll temperature sensors and update fan speed.
	//pollThermistors(temperatureArr);
	//setFanSpeed(temperatureArr);
	

	//TODO: IN PROGRESS: Poll battery voltage sensors over I2C
	//pollBMSVoltagesOLD(BMSVoltageArr);
	digitalWrite(PURGE_PIN, HIGH);
	pollBMSVoltages(BMSVoltageArr);
	for(int i = 0; i < 9; i++){
		Serial.print(BMSVoltageArr[i], 4);
		Serial.print(", ");
	}
	digitalWrite(PURGE_PIN, LOW);
	delay(100);
	Serial.println(" :: ");
	//TODO: Write to SD CARD
	
	//TODO: Write to receiver over XBee.
	

}	

void pollBMSVoltages(double BMSVoltageArr[9]){
	byte i2cByte1 = 0;
	byte i2cByte2 = 0;
	double vPerDiv = 5.0/1024.0;
	int startTime = 0;
	bool failedFlag = false;

	for(int i = 0; i < 9; i++){
		failedFlag = false;
		I2c.read(BMS_addr_arr[i], 2);	// Request 2 bytes from the BMS voltage board
		startTime = millis();
		while(I2c.available() < 2){			// Wait until 2 bytes available, use a timeout to prevent hanging
			if((millis() - startTime) >= BMS_REQUEST_TIMEOUT){
				failedFlag = true;
				break;
			}
		}
		if(!failedFlag){
			i2cByte1 = I2c.receive();
			i2cByte2 = I2c.receive();
			BMSVoltageArr[i] = (i2cByte1 + (256 * i2cByte2)) * vPerDiv;
		}
		else{
			Serial.println("========== BROKEN ===========");
			BMSVoltageArr[i] = 0.0;
		}
	}
	return;
}

void pollThermistors(double thermistorArr[6]){	// Polls thermistors, converts voltage to a temperature, returns temps and mean temp.
	// Read the thermistors.
	int thermistorArrTMP[5] = {0, 0, 0, 0, 0};	// Stores the raw 0-1023 value returned by analogRead(PIN).

	thermistorArrTMP[0] = analogRead(THERMISTOR_IN_1);	// Maps to 0-1023 for 0V-5V. 0.004883V/increment.
	thermistorArrTMP[1] = analogRead(THERMISTOR_IN_2);	
	thermistorArrTMP[2] = analogRead(THERMISTOR_IN_3);	
	thermistorArrTMP[3] = analogRead(THERMISTOR_IN_4);	
	thermistorArrTMP[4] = analogRead(THERMISTOR_IN_5);	
	
	// LUT to get temps for each.
	thermistorArr[0] = thermistorTempLUT[thermistorArrTMP[0]];
	thermistorArr[1] = thermistorTempLUT[thermistorArrTMP[1]];
	thermistorArr[2] = thermistorTempLUT[thermistorArrTMP[2]];
	thermistorArr[3] = thermistorTempLUT[thermistorArrTMP[3]];
	thermistorArr[4] = thermistorTempLUT[thermistorArrTMP[4]];
	
	// Compute average
	double totalTmp = 0;
	for(int i = 0; i < 6; i++){
		totalTmp += thermistorArr[i];
	}
	thermistorArr[5] = totalTmp/6;
	return;
}

void setFanSpeed(double temperatureArr[6]){	// Linear controller for fuel cell cooling fans
	int tDiff = temperatureArr[5] - FUEL_CELL_IDEAL_TEMP;	// > ideal is +ve, < ideal is -ve.
	float fanSpeed = FUEL_CELL_STANDARD_FANSPEED + (tDiff * FUEL_CELL_FAN_CONTROL_SENSITIVITY);
	
	// Clamp fanSpeed
	if(fanSpeed < FUEL_CELL_MIN_FANSPEED){
		fanSpeed = FUEL_CELL_MIN_FANSPEED;
	}
	if(fanSpeed >= 255){
		fanSpeed = 255;
	}
	
	// Check if panic fullspeed on individuals or mean temp.
	for(int i = 0; i < 6; i++){
		if(temperatureArr[i] >= FUEL_CELL_INDIVIDUAL_MAX_TEMP){
			fanSpeed = 255;
		}
	}
	analogWrite(FAN_CONTROL_PIN, fanSpeed);
}

ISR(TIMER1_COMPA_vect){ // ISR handles purge valve opening/closing.
	if(valveOpen == 1){
		valveOpenCounter++;
		if(valveOpenCounter >= (2 * PURGE_OPEN_SECONDS)){
			Serial.println("CLOSE VALVE");
			digitalWrite(PURGE_PIN, LOW);
			valveOpenCounter = 0;		// Valve open timer reset to 0.
			valveOpen = 0;				// Valve status reset to closed.
		}
	}
	else{
		time1Counter++;
		if(time1Counter >= (2 * PURGE_CLOSED_SECONDS)){
			Serial.println("OPEN VALVE");
    		digitalWrite(PURGE_PIN, HIGH);
			time1Counter = 0;			// Valve closed timer reset to 0.
			valveOpen = 1;				// Valve status set to open.
		}
	}
}



